//Revise Radial POV 6/27/18
//includes 6 Images Cycle Max on 32K


const uint8_t chipled[] PROGMEM = {0};
const uint8_t numstrip[] PROGMEM = {1};
const uint8_t numradios[] PROGMEM = {1};
const uint8_t radio1directo[] PROGMEM = {1};
const uint8_t radio2directo[] PROGMEM = {1};
const uint8_t radio2180[] PROGMEM = {0};
const uint8_t offset1[] PROGMEM = {0};
const uint8_t offset2[] PROGMEM = {0};
const uint8_t brillo[] PROGMEM = {5};
const uint8_t animate[] PROGMEM = {0};
const uint8_t num_leds[] PROGMEM = {30};

//----------------------------------------------------------------------------------------------------------------------------------------------------------------------------------------
// Codes that Drives the images

//IMAGE 1
const uint16_t numpasos[] PROGMEM = {167};
const uint16_t angreducido[] PROGMEM = {228};
const uint16_t sizePolarRedu[] PROGMEM = {1179};
const uint8_t PolarRedu[1179] PROGMEM = {0,1,5,0,2,5,0,3,1,0,4,1,0,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27,5};


//IMAGE 2
const uint16_t numpasos2[] PROGMEM = {186};
const uint16_t angreducido2[] PROGMEM = {252};
const uint16_t sizePolarRedu2[] PROGMEM = {936};
const uint8_t PolarRedu2[936] PROGMEM = {0,1,0,0,2,0,0,3,0,0,4,0,0,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11,0};


//IMAGE 3
const uint16_t numpasos3[] PROGMEM = {351};
const uint16_t angreducido3[] PROGMEM = {1437};
const uint16_t sizePolarRedu3[] PROGMEM = {6018};
const uint8_t PolarRedu3[6018] PROGMEM = {0,1,0,0,2,0,0,3,0,0,4,0,0,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24,0};


//IMAGE 4
const uint16_t numpasos4[] PROGMEM = {354};
const uint16_t angreducido4[] PROGMEM = {1197};
const uint16_t sizePolarRedu4[] PROGMEM = {5040};
const uint8_t PolarRedu4[5040] PROGMEM = {0,1,0,0,2,0,0,3,0,0,4,0,0,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19,3};


//IMAGE 5
const uint16_t numpasos5[] PROGMEM = {322};
const uint16_t angreducido5[] PROGMEM = {636};
const uint16_t sizePolarRedu5[] PROGMEM = {2832};
const uint8_t PolarRedu5[2832] PROGMEM = {0,1,0,0,2,0,0,3,0,0,4,0,0,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21,3};

//IMAGE 6
const uint16_t numpasos6[] PROGMEM = {125};
const uint16_t angreducido6[] PROGMEM = {125};
const uint16_t sizePolarRedu6[] PROGMEM = {543};
const uint8_t PolarRedu6[543] PROGMEM = {0,1,0,0,2,0,0,3,0,0,4,0,0,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26,0};


//IMAGE 7
const uint16_t numpasos7[] PROGMEM = {349};
const uint16_t angreducido7[] PROGMEM = {885};
const uint16_t sizePolarRedu7[] PROGMEM = {3702};
const uint8_t PolarRedu7[3702] PROGMEM = {0,1,2,0,2,0,0,3,0,0,4,0,0,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13,5};


//IMAGE 8
const uint16_t numpasos8[] PROGMEM = {359};
const uint16_t angreducido8[] PROGMEM = {1474};
const uint16_t sizePolarRedu8[] PROGMEM = {6270};
const uint8_t PolarRedu8[6270] PROGMEM = {0,1,2,0,2,0,0,3,0,0,4,0,0,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17,3};


//----------------------------------------------------------------------------------------------------------------------------------------------------------------------------------------
#include <avr/pgmspace.h>
#include "FastLED.h"
CRGB leds[141];
int angulo;
unsigned int numled;
unsigned int k = 0;
bool pasa = false;
bool cambiaLed = false;
long tiempoDibujo = 0;
long periodo = 0;
long periodoini = 0;
long previoustime = 0;
long tiempo = 0;
long contaseconds = 0;
unsigned int ang = 360;
long tvariable = 0;
int tiempoescritura = 700;
byte LedColour = 0;
byte vred = 0;
byte vgreen = 0;
byte vblue = 0;
int angAux = 0;
int anginicio = 360;
int kinicial = 0;
int contaang = 0;
long tiempoanimate = 0;

//Millis Timer
int period = 1000;
unsigned long time_now = 0;

//----------------------------------------------------------------------------------------------------------------------------------------------------------------------------------------
void setup() {
//Fast LED Codes
pinMode(A2, INPUT);
digitalWrite(A2, LOW);
FastLED.addLeds<APA102>(leds, pgm_read_byte(num_leds + 0) + pgm_read_byte(offset1 + 0));
FastLED.setBrightness(pgm_read_byte(brillo + 0));

//Interruptor
attachInterrupt(digitalPinToInterrupt(2), pasaIman, RISING); // Philippine
attachInterrupt(digitalPinToInterrupt(2), pasaIman2, RISING);//FP
attachInterrupt(digitalPinToInterrupt(2), pasaIman3, RISING);//machi
attachInterrupt(digitalPinToInterrupt(2), pasaIman4, RISING);//make
attachInterrupt(digitalPinToInterrupt(2), pasaIman5, RISING);//MM
attachInterrupt(digitalPinToInterrupt(2), pasaIman6, RISING);//machi
attachInterrupt(digitalPinToInterrupt(2), pasaIman7, RISING);//make
attachInterrupt(digitalPinToInterrupt(2), pasaIman8, RISING);//MM


memset(leds, 0, 141*3);
FastLED.show();
}

//----------------------------------------------------------------------------------------------------------------------------------------------------------------------------------------
void loop() {
  
time_now = millis();  
//IMAGE 1
while(millis() < time_now + 2000){
{AA();}}
//IMAGE 2
while(millis() < time_now + 4000){
{BB();}}
//IMAGE 3
while(millis() < time_now + 6000){
{CC();}}
//IMAGE 4
while(millis() < time_now + 7000){
{DD();}}
//IMAGE 5
while(millis() < time_now + 8000){
{EE();}}
//IMAGE 6
while(millis() < time_now + 9000){
{FF();}}
//IMAGE 7
//while(millis() < time_now + 10000){
//{GG();}}
//IMAGE 8
//while(millis() < time_now + 11000){
//{HH();}}


};

