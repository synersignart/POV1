//Revise Radial POV 6/27/18
//includes 10 Images Cycle


const uint8_t chipled[] PROGMEM = {0};
const uint8_t numstrip[] PROGMEM = {1};
const uint8_t numradios[] PROGMEM = {1};
const uint8_t radio1directo[] PROGMEM = {1};
const uint8_t radio2directo[] PROGMEM = {1};
const uint8_t radio2180[] PROGMEM = {0};
const uint8_t offset1[] PROGMEM = {0};
const uint8_t offset2[] PROGMEM = {0};
const uint8_t brillo[] PROGMEM = {25};
const uint8_t animate[] PROGMEM = {0};
const uint8_t num_leds[] PROGMEM = {30};

//----------------------------------------------------------------------------------------------------------------------------------------------------------------------------------------
// Codes that Drives the images

//IMAGE 1 Strange red
const uint16_t numpasos[] PROGMEM = {277};
const uint16_t angreducido[] PROGMEM = {364};
const uint16_t sizePolarRedu[] PROGMEM = {1542};
const uint8_t PolarRedu[1542] PROGMEM = {0,1,0,0,2,0,0,3,0,0,4,0,0,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26,2};


//IMAGE 2 Strange orange
const uint16_t numpasos2[] PROGMEM = {318};
const uint16_t angreducido2[] PROGMEM = {561};
const uint16_t sizePolarRedu2[] PROGMEM = {2343};
const uint8_t PolarRedu2[2343] PROGMEM = {0,1,0,0,2,0,0,3,0,0,4,0,0,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22,1};


//IMAGE 3 S1
const uint16_t numpasos3[] PROGMEM = {351};
const uint16_t angreducido3[] PROGMEM = {938};
const uint16_t sizePolarRedu3[] PROGMEM = {3972};
const uint8_t PolarRedu3[3972] PROGMEM = {0,1,0,0,2,0,0,3,0,0,4,2,0,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24,2};


//IMAGE 4 S2
const uint16_t numpasos4[] PROGMEM = {351};
const uint16_t angreducido4[] PROGMEM = {937};
const uint16_t sizePolarRedu4[] PROGMEM = {3966};
const uint8_t PolarRedu4[3966] PROGMEM = {0,1,0,0,2,0,0,3,0,0,4,2,0,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21,0};


//IMAGE 5 S3
const uint16_t numpasos5[] PROGMEM = {351};
const uint16_t angreducido5[] PROGMEM = {958};
const uint16_t sizePolarRedu5[] PROGMEM = {3960};
const uint8_t PolarRedu5[3960] PROGMEM = {0,1,0,0,2,0,0,3,2,0,4,2,0,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24,0};

//IMAGE 6 S4
const uint16_t numpasos6[] PROGMEM = {351};
const uint16_t angreducido6[] PROGMEM = {948};
const uint16_t sizePolarRedu6[] PROGMEM = {3963};
const uint8_t PolarRedu6[3963] PROGMEM = {0,1,0,0,2,0,0,3,2,0,4,2,0,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25,5};


//IMAGE 7 Flyingpromotions
const uint16_t numpasos7[] PROGMEM = {186};
const uint16_t angreducido7[] PROGMEM = {252};
const uint16_t sizePolarRedu7[] PROGMEM = {936};
const uint8_t PolarRedu7[936] PROGMEM = {0,1,0,0,2,0,0,3,0,0,4,0,0,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11,0};


//IMAGE 8
const uint16_t numpasos8[] PROGMEM = {359};
const uint16_t angreducido8[] PROGMEM = {1474};
const uint16_t sizePolarRedu8[] PROGMEM = {6270};
const uint8_t PolarRedu8[6270] PROGMEM = {0,1,2,0,2,0,0,3,0,0,4,0,0,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17,3};

//IMAGE 9
const uint16_t numpasos9[] PROGMEM = {358};
const uint16_t angreducido9[] PROGMEM = {1655};
const uint16_t sizePolarRedu9[] PROGMEM = {6942};
const uint8_t PolarRedu9[6942] PROGMEM = {0,1,0,0,2,0,0,3,0,0,4,0,0,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14,0};

//IMAGE 10
const uint16_t numpasos10[] PROGMEM = {360};
const uint16_t angreducido10[] PROGMEM = {1629};
const uint16_t sizePolarRedu10[] PROGMEM = {6987};
const uint8_t PolarRedu10[6987] PROGMEM = {0,1,0,0,2,0,0,3,0,0,4,0,0,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23,0};

//----------------------------------------------------------------------------------------------------------------------------------------------------------------------------------------
#include <avr/pgmspace.h>
#include "FastLED.h"
CRGB leds[141];
int angulo;
unsigned int numled;
unsigned int k = 0;
bool pasa = false;
bool cambiaLed = false;
long tiempoDibujo = 0;
long periodo = 0;
long periodoini = 0;
long previoustime = 0;
long tiempo = 0;
long contaseconds = 0;
unsigned int ang = 360;
long tvariable = 0;
int tiempoescritura = 700;
byte LedColour = 0;
byte vred = 0;
byte vgreen = 0;
byte vblue = 0;
int angAux = 0;
int anginicio = 360;
int kinicial = 0;
int contaang = 0;
long tiempoanimate = 0;

//Millis Timer
int period = 1000;
unsigned long time_now = 0;

//----------------------------------------------------------------------------------------------------------------------------------------------------------------------------------------
void setup() {
//Fast LED Codes
pinMode(A2, INPUT);
digitalWrite(A2, LOW);
FastLED.addLeds<APA102>(leds, pgm_read_byte(num_leds + 0) + pgm_read_byte(offset1 + 0));
FastLED.setBrightness(pgm_read_byte(brillo + 0));

//Interruptor
attachInterrupt(digitalPinToInterrupt(2), pasaIman, RISING); //AA
attachInterrupt(digitalPinToInterrupt(2), pasaIman2, RISING);//BB
attachInterrupt(digitalPinToInterrupt(2), pasaIman3, RISING);//CC
attachInterrupt(digitalPinToInterrupt(2), pasaIman4, RISING);//DD
attachInterrupt(digitalPinToInterrupt(2), pasaIman5, RISING);//EE
attachInterrupt(digitalPinToInterrupt(2), pasaIman6, RISING);//FF
attachInterrupt(digitalPinToInterrupt(2), pasaIman7, RISING);//GG
attachInterrupt(digitalPinToInterrupt(2), pasaIman8, RISING);//HH
attachInterrupt(digitalPinToInterrupt(2), pasaIman9, RISING);//II
attachInterrupt(digitalPinToInterrupt(2), pasaIman10, RISING);//JJ

memset(leds, 0, 141*3);
FastLED.show();
}

//----------------------------------------------------------------------------------------------------------------------------------------------------------------------------------------
void loop() {
  
time_now = millis();  
//IMAGE 2 orange
while(millis() < time_now + 2000){
{BB();}}
//IMAGE 2 orange
while(millis() < time_now + 4000){
{BB();}}


//IMAGE 3 S1
while(millis() < time_now + 6000){
{CC();}}
//IMAGE 4 S2
while(millis() < time_now + 6250){
{DD();}}
//IMAGE 5 S3
while(millis() < time_now + 6500){
{EE();}}
//IMAGE 6 S4
while(millis() < time_now + 6750){
{FF();}}


//IMAGE 3 S1
while(millis() < time_now + 7000){
{CC();}}
//IMAGE 4 S2
while(millis() < time_now + 7250){
{DD();}}
//IMAGE 5 S3
while(millis() < time_now + 7500){
{EE();}}
//IMAGE 6 S4
while(millis() < time_now + 7750){
{FF();}}


//IMAGE 3 S1
while(millis() < time_now + 8000){
{CC();}}
//IMAGE 4 S2
while(millis() < time_now + 8250){
{DD();}}
//IMAGE 5 S3
while(millis() < time_now + 8500){
{EE();}}
//IMAGE 6 S4
while(millis() < time_now + 8750){
{FF();}}


//IMAGE 7 FlyingPromotions
//while(millis() < time_now + 9000){
//{GG();}}

//IMAGE 8
//while(millis() < time_now + 11000){
//{HH();}}
//IMAGE 9
//while(millis() < time_now + 12000){
//{II();}}
//IMAGE 10
//while(millis() < time_now + 13000){
//{JJ();}}

};

